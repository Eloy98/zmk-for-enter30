## config/boards/shields/enter30/Kconfig.shield
```kconfig
# Copyright (c) 2020 The ZMK Contributors
# SPDX-License-Identifier: MIT

config SHIELD_ENTER30
    def_bool $(shields_list_contains,enter30)
```
